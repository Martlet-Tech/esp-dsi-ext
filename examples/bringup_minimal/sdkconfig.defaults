## examples/bringup_minimal/sdkconfig.defaults
```kconfig
# 目标芯片。ESP32-P4 才有 MIPI DSI host。
CONFIG_IDF_TARGET="esp32p4"

# PSRAM：framebuffer 需要，540x810x3 就要 1.3MB
CONFIG_SPIRAM=y
CONFIG_SPIRAM_MODE_HEX=y
CONFIG_SPIRAM_SPEED_200M=y

CONFIG_FREERTOS_HZ=1000
CONFIG_LOG_DEFAULT_LEVEL_INFO=y
```
